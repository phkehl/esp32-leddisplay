## Kconfig
```kconfig
menu "LED Display"

    choice
        prompt "display type"
        default LEDDISPLAY_TYPE_64X32_16SCAN
        help
            The LED display type.

        # these work:

        config LEDDISPLAY_TYPE_32X16_8SCAN
            bool "32x16 1/8 scan"

        config LEDDISPLAY_TYPE_32X32_16SCAN
            bool "32x32 1/16 scan"

        config LEDDISPLAY_TYPE_64X32_16SCAN
            bool "64x32 1/16 scan"

        config LEDDISPLAY_TYPE_64X64_32SCAN
            bool "64x64 1/32 scan"

        # these don't work:
        #
        #config LEDDISPLAY_TYPE_32X16_4SCAN
        #    bool "32x16 1/4 scan (doesn't work)"
        #
        #config LEDDISPLAY_TYPE_32X32_8SCAN
        #    bool "32x32 1/8 scan (doesn't work!)"
        #
        #config LEDDISPLAY_TYPE_64X32_8SCAN
        #    bool "64x32 1/8 scan (doesn't work!)"

        # what more exists?

    endchoice

    choice LEDDISPLAY_I2S_FREQ
        prompt "I2S frequency"
        default LEDDISPLAY_I2S_FREQ_20MHZ
        help
            generally choose as high as possible / working

        config LEDDISPLAY_I2S_FREQ_13MHZ
            bool "13.3 MHz"

        config LEDDISPLAY_I2S_FREQ_16MHZ
            bool "16 MHz"

        config LEDDISPLAY_I2S_FREQ_20MHZ
            bool "20 MHz"

        config LEDDISPLAY_I2S_FREQ_26MHZ
            bool "26.6 MHz"

    endchoice

    config LEDDISPLAY_PRESERVE_RAM_SIZE
        int "keep this much (DMA) RAM free [bytes]"
        default 64000

    config LEDDISPLAY_MIN_FRAME_RATE
        int "minimum frame refresh rate [Hz]"
        default 50

    # see val2pwm.c
    choice LEDDISPLAY_CORR_BRIGHT
        prompt "correct perceived brightness"
        default LEDDISPLAY_CORR_BRIGHT_MODIFIED

        config LEDDISPLAY_CORR_BRIGHT_NONE
            bool "no brightness correction"

        config LEDDISPLAY_CORR_BRIGHT_STRICT
            bool "strict brightness correction"
            help
                colour values < 10 is LED fully off, and only values >= 10 will lit the LED,
                using original brightness correction curve

        config LEDDISPLAY_CORR_BRIGHT_MODIFIED
            bool "modified brightness correction"
            help
                only colour value 0 is LED fully off, and any value > 0 will lit the LED,
                the original correction curve is scaled accordingly

    endchoice

    config LEDDISPLAY_R1_GPIO
        int "GPIO for the R1 signal"
        default 2
        range 0 35
        help
            typically usable pins are 2, 4-5, 12-33

    config LEDDISPLAY_G1_GPIO
        int "GPIO for the G1 signal"
        default 15
        range 0 33
        help
            typically usable pins are 2, 4-5, 12-33

    config LEDDISPLAY_B1_GPIO
        int "GPIO for the B1 signal"
        default 4
        range 0 33
        help
            typically usable pins are 2, 4-5, 12-33

    config LEDDISPLAY_R2_GPIO
        int "GPIO for the R2 signal"
        default 16
        range 0 33
        help
            typically usable pins are 2, 4-5, 12-33

    config LEDDISPLAY_G2_GPIO
        int "GPIO for the G2 signal"
        default 27
        range 0 33
        help
            typically usable pins are 2, 4-5, 12-33

    config LEDDISPLAY_B2_GPIO
        int "GPIO for the B2 signal"
        default 17
        range 0 33
        help
            typically usable pins are 2, 4-5, 12-33

    config LEDDISPLAY_A_GPIO
        int "GPIO for the A signal"
        default 5
        range 0 33
        help
            typically usable pins are 2, 4-5, 12-33

    config LEDDISPLAY_B_GPIO
        int "GPIO for the B signal"
        default 18
        range 0 33
        help
            typically usable pins are 2, 4-5, 12-33

    config LEDDISPLAY_C_GPIO
        int "GPIO for the C signal"
        default 19
        range 0 33
        help
            typically usable pins are 2, 4-5, 12-33

    config LEDDISPLAY_D_GPIO
        int "GPIO for the D signal"
        default 21
        range 0 33
        help
            typically usable pins are 2, 4-5, 12-33

    config LEDDISPLAY_E_GPIO
        int "GPIO for the E signal (1/32 scan types only)"
        default -1
        range -1 33
        help
            typically usable pins are 2, 4-5, 12-33

    config LEDDISPLAY_LAT_GPIO
        int "GPIO for the LAT signal"
        default 26
        range 0 33
        help
            typically usable pins are 2, 4-5, 12-33

    config LEDDISPLAY_OE_GPIO
        int "GPIO for the OE signal"
        default 25
        range 0 33
        help
            typically usable pins are 2, 4-5, 12-33

    config LEDDISPLAY_CLK_GPIO
        int "GPIO for the CLK signal"
        default 22
        range 0 33
        help
            typically usable pins are 2, 4-5, 12-33

endmenu
```

## examples/leddisplay_nyancat/sdkconfig.defaults
```kconfig
# monitor and console (stdio)
CONFIG_MONITOR_BAUD=115200
CONFIG_CONSOLE_UART_DEFAULT=y
CONFIG_CONSOLE_UART_BAUDRATE=115200

# uncomment to increase CPU clock (speed)
#CONFIG_ESP32_DEFAULT_CPU_FREQ_240=y
#CONFIG_ESP32_DEFAULT_CPU_FREQ_MHZ=240

# debugging output by default
CONFIG_LOG_DEFAULT_LEVEL_DEBUG=y
CONFIG_LOG_DEFAULT_LEVEL=4

# needed for mon.c functionality
CONFIG_FREERTOS_USE_TRACE_FACILITY=y
CONFIG_FREERTOS_USE_STATS_FORMATTING_FUNCTIONS=y
CONFIG_FREERTOS_VTASKLIST_INCLUDE_COREID=y
CONFIG_FREERTOS_GENERATE_RUN_TIME_STATS=y
CONFIG_FREERTOS_RUN_TIME_STATS_USING_ESP_TIMER=y

# display pins
#CONFIG_LEDDISPLAY_R1_GPIO=2
#CONFIG_LEDDISPLAY_G1_GPIO=15
#CONFIG_LEDDISPLAY_B1_GPIO=4
#CONFIG_LEDDISPLAY_R2_GPIO=16
#CONFIG_LEDDISPLAY_G2_GPIO=27
#CONFIG_LEDDISPLAY_B2_GPIO=17
#CONFIG_LEDDISPLAY_A_GPIO=5
#CONFIG_LEDDISPLAY_B_GPIO=18
#CONFIG_LEDDISPLAY_C_GPIO=19
#CONFIG_LEDDISPLAY_D_GPIO=21
#CONFIG_LEDDISPLAY_E_GPIO=-1
#CONFIG_LEDDISPLAY_CLK_GPIO=22
#CONFIG_LEDDISPLAY_LAT_GPIO=26
#CONFIG_LEDDISPLAY_OE_GPIO=25
```

## examples/leddisplay_test/sdkconfig.defaults
```kconfig
# monitor and console (stdio)
CONFIG_MONITOR_BAUD=115200
CONFIG_CONSOLE_UART_DEFAULT=y
CONFIG_CONSOLE_UART_BAUDRATE=115200

# uncomment to increase CPU clock (speed)
#CONFIG_ESP32_DEFAULT_CPU_FREQ_240=y
#CONFIG_ESP32_DEFAULT_CPU_FREQ_MHZ=240

# debugging output by default
CONFIG_LOG_DEFAULT_LEVEL_DEBUG=y
CONFIG_LOG_DEFAULT_LEVEL=4
```
